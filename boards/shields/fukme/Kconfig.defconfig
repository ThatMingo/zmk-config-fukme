## boards/shields/fukme/Kconfig.defconfig
```kconfig
if SHIELD_FUKME

# Name must be less than 16 characters long!
config ZMK_KEYBOARD_NAME
    default "fukme"

endif
```

## boards/shields/fukme/Kconfig.shield
```kconfig
# No whitespace after the comma or in your keyboard name!
config SHILED_FUKME
    def_bool $(shields_list_contains,fukme)
```
